## boards/winegard/iothub/Kconfig.iothub
```kconfig
# Copyright (c) 2024 Nordic Semiconductor ASA
# SPDX-License-Identifier: Apache-2.0

config BOARD_IOTHUB
	select SOC_NRF54H20_CPUAPP if BOARD_IOTHUB_NRF54H20_CPUAPP
	select SOC_NRF54H20_CPURAD if BOARD_IOTHUB_NRF54H20_CPURAD
	select SOC_NRF54H20_CPUPPR if (BOARD_IOTHUB_NRF54H20_CPUPPR || \
				       BOARD_IOTHUB_NRF54H20_CPUPPR_XIP)
	select SOC_NRF54H20_CPUFLPR if (BOARD_IOTHUB_NRF54H20_CPUFLPR || \
				        BOARD_IOTHUB_NRF54H20_CPUFLPR_XIP)
```

## boards/winegard/iothub/Kconfig.sysbuild
```kconfig
# Copyright (c) 2025 Nordic Semiconductor ASA
# SPDX-License-Identifier: Apache-2.0

if BOARD_IOTHUB_NRF54H20_CPURAD

config NRF_DEFAULT_EMPTY
	default y

endif # BOARD_IOTHUB_NRF54H20_CPURAD
```

## boards/winegard/iothub/board.yml
```yaml
board:
  name: iothub
  full_name: IOTHUB
  vendor: nordic
  socs:
  - name: nrf54h20
    variants:
    - name: xip
      cpucluster: cpuppr
    - name: xip
      cpucluster: cpuflpr
  revision:
    format: major.minor.patch
    default: "0.9.0"
    revisions:
    - name: "0.9.0"
```

## subsys/Kconfig
```kconfig
menu "Winegard Subsystems"
# zephyr-keep-sorted-start
rsource "pwr_detect/Kconfig"
# zephyr-keep-sorted-stop
endmenu
```

## subsys/pwr_detect/Kconfig
```kconfig
menuconfig PWR_DETECT
	bool "Power Detection Subsystem"
	default n
	help
		This option enables the power detection subsystem.

menuconfig PWR_DETECT_LOG_LEVEL
	int "Power Detection Log Level"
	default 3
	depends on PWR_DETECT
	help
		Set the log level for the power detection subsystem.
		0 - None
		1 - Error
		2 - Warning
		3 - Info
		4 - Debug

menuconfig PWR_DETECT_SAMPLE_RATE
	int "Power Detection Sample Rate (Hz)"
	default 1
	depends on PWR_DETECT
	help
		Set the sample rate for power detection in Hertz.

menuconfig PWR_DETECT_SHELL
	bool "Enable Power Detection Shell Commands"
	default n
	depends on PWR_DETECT
	select SHELL_GETOPT
	help
		Enable shell commands for interacting with the power detection subsystem.				
```
