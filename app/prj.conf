## Kconfig
```
# Copyright (c) 2021 Nordic Semiconductor ASA
# SPDX-License-Identifier: Apache-2.0
#
# This file is the application Kconfig entry point. All application Kconfig
# options can be defined here or included via other application Kconfig files.
# You can browse these options using the west targets menuconfig (terminal) or
# guiconfig (GUI).

#menu "Zephyr"
#source "Kconfig.zephyr"
#endmenu

menu "Nordic Shell sample"

if NET_BUF_FIXED_DATA_SIZE

config NET_BUF_DATA_SIZE
	default 1100

endif

# Configure variable network buffer pool sizes for TX and RX
if NET_BUF_VARIABLE_DATA_SIZE

# nRF52 and nRF54 Series targets have less memory
# so smaller pool sizes are recommended for these targets.
config NET_PKT_BUF_TX_DATA_POOL_SIZE
	default 40000 if SOC_SERIES_NRF54HX
	default 50000 if !SOC_SERIES_NRF52X && !SOC_SERIES_NRF54LX

config NET_PKT_BUF_RX_DATA_POOL_SIZE
	default 20000 if !SOC_SERIES_NRF52X && !SOC_SERIES_NRF54LX

endif

source "Kconfig.zephyr"

endmenu

module = APP
module-str = APP
source "subsys/logging/Kconfig.template.log_config"
```

## sample.yaml
```
# This file is provided so that the application can be compiled using Twister,
# the Zephyr testing tool. In this file, multiple combinations can be specified,
# so that you can easily test all of them locally or in CI.
sample:
  description: Example application
  name: example-application
common:
  sysbuild: true
  build_only: true
  integration_platforms:
    - iothub/nrf54h20/cpuapp
    - nrf54l15dk/nrf54l15/cpuapp
tests:
  app.default: {}
  app.debug:
    extra_overlay_confs:
      - debug.conf
```

## prj.conf
```kconfig
# Copyright (c) 2021 Nordic Semiconductor ASA
# SPDX-License-Identifier: Apache-2.0
#
# This file contains selected Kconfig options for the application.
CONFIG_SOC_NRF54H20_GENERATE_BICR=y
CONFIG_MULTITHREADING=y
CONFIG_LOG=y
CONFIG_ADC=y

# Power Detection Configuration
CONFIG_PWR_DETECT=y
CONFIG_PWR_DETECT_LOG_LEVEL=3

# Shell Configuration
CONFIG_SHELL=y
CONFIG_PWR_DETECT_SHELL=y
```

## src/main.c
```c
#include <stdio.h>
#include <zephyr/kernel.h>
#include <zephyr/device.h>
#include <zephyr/drivers/gpio.h>
/* 1000 msec = 1 sec */
#define SLEEP_TIME_MS   1000

/* The devicetree node identifier for the "led0" alias. */
#define LED0_NODE DT_ALIAS(greenled)
#define LED1_NODE DT_ALIAS(redled)
#define LED2_NODE DT_ALIAS(blueled)
#define BUTTON_NODE DT_ALIAS(sw0)
/*
 * A build error on this line means your board is unsupported.
 * See the sample documentation for information on how to fix this.
 */
static const struct gpio_dt_spec led0 = GPIO_DT_SPEC_GET(LED0_NODE, gpios);
static const struct gpio_dt_spec led1 = GPIO_DT_SPEC_GET(LED1_NODE, gpios);
static const struct gpio_dt_spec led2 = GPIO_DT_SPEC_GET(LED2_NODE, gpios);

static const struct gpio_dt_spec button = GPIO_DT_SPEC_GET(BUTTON_NODE, gpios);

#define DEBOUNCE_DELAY_MS 500
static int64_t last_interrupt_time = 0;
void pin_isr(const struct device *dev, struct gpio_callback *cb, uint32_t pins)
{
	int64_t current_time = k_uptime_get();
	if ((current_time - last_interrupt_time) < DEBOUNCE_DELAY_MS) {
		// Debounce: Ignore interrupts that occur within the debounce interval
		return;
	}
	last_interrupt_time = current_time;
	// Handle the button press event here
	printf("Button Interupt\n");
	gpio_pin_toggle_dt(&led0);
	return; 
}

int main(void)
{
	int ret;
	//int val;
	static struct gpio_callback pin_cb_data;
//	bool led_state = true;


	if (!gpio_is_ready_dt(&led0)) {
		printf("led0 not ready\n");
		return 0;
	}
	
	if (!gpio_is_ready_dt(&led1)) {
		printf("led1 not ready\n");
		return 0;
	}
	
	if (!gpio_is_ready_dt(&led2)) {
		printf("led2 not ready\n");
		return 0;
	}

	
	ret = gpio_pin_configure_dt(&led0, GPIO_OUTPUT_ACTIVE);
	if (ret < 0) {
		printf("led0 failed to configure\n");
		return 0;
	}

	ret = gpio_pin_configure_dt(&led1, GPIO_OUTPUT_ACTIVE);
	if (ret < 0) {
		printf("led1 failed to configure\n");
		return 0;
	}

	ret = gpio_pin_configure_dt(&led2, GPIO_OUTPUT_ACTIVE);
	if (ret < 0) {
		printf("led2 failed to configure\n");
		return 0;
	}

	ret = gpio_pin_configure_dt(&button, GPIO_INPUT | GPIO_PULL_UP | GPIO_ACTIVE_LOW);
	if (ret < 0) {
		printf("button failed to configure\n");
		return 0;
	}


	gpio_pin_interrupt_configure_dt(&button,GPIO_INT_EDGE_TO_ACTIVE);
	//ret = gpio_pin_interrupt_configure_dt(&button, GPIO_INT_EDGE_FALLING);	
	gpio_init_callback(&pin_cb_data, pin_isr, BIT(button.pin));
	gpio_add_callback(button.port, &pin_cb_data);
	gpio_pin_set_dt(&led0, 1);

	while (1) {
		
		//ret = gpio_pin_toggle_dt(&led0);
		if (ret < 0) {
			return 0;
		}

		k_msleep(SLEEP_TIME_MS);
		//ret = gpio_pin_set_dt(&led0, 0);
		//ret = gpio_pin_set_dt(&led1, 0);
		//ret = gpio_pin_set_dt(&led2, 0);
		if (ret < 0) {
			return 0;
		}
		ret = gpio_pin_set_dt(&led1, 1);
		//ret = gpio_pin_toggle_dt(&led1);
		if (ret < 0) {
			return 0;
		}

		k_msleep(SLEEP_TIME_MS);
		ret = gpio_pin_set_dt(&led1, 0);
		ret = gpio_pin_set_dt(&led2, 1);
		//ret = gpio_pin_toggle_dt(&led1);
		if (ret < 0) {
			return 0;
		}
		k_msleep(SLEEP_TIME_MS);
		ret = gpio_pin_set_dt(&led2, 0);
	//	ret = gpio_pin_toggle_dt(&led2);
		if (ret < 0) {
			return 0;
		}

		//val = gpio_pin_get_dt(&button);
		//printf("Waiting for button interrupt...\n");
		//break;
		//printf("Button state: %d\n", val);
	}
	return 0;
}
```
